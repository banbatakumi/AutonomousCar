#include "ld06.h"

// マニュアル記載のCRC8用計算テーブル
static const uint8_t CrcTable[256] = {
    0x00, 0x4d, 0x9a, 0xd7, 0x79, 0x34, 0xe3, 0xae, 0xf2, 0xbf, 0x68, 0x25, 0x8b, 0xc6, 0x11, 0x5c,
    0xa9, 0xe4, 0x33, 0x7e, 0xd0, 0x9d, 0x4a, 0x07, 0x5b, 0x16, 0xc1, 0x8c, 0x22, 0x6f, 0xb8, 0xf5,
    0x1f, 0x52, 0x85, 0xc8, 0x66, 0x2b, 0xfc, 0xb1, 0xed, 0xa0, 0x77, 0x3a, 0x94, 0xd9, 0x0e, 0x43,
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    0xf4, 0xb9, 0x6e, 0x23, 0x8d, 0xc0, 0x17, 0x5a, 0x06, 0x4b, 0x9c, 0xd1, 0x7f, 0x32, 0xe5, 0xa8};

// CRC計算用関数
static uint8_t CalCRC8(const uint8_t* p, uint8_t len) {
  uint8_t crc = 0;
  for (uint8_t i = 0; i < len; i++) {
    crc = CrcTable[(crc ^ p[i]) & 0xff];
  }
  return crc;
}

void LD06_Init(LD06* lidar, Serial* serial, PwmOut* motor_control) {
  lidar->serial = serial;
  lidar->motor = motor_control;
  lidar->rx_state = 0;
  lidar->speed_dps = 0.0f;
  lidar->span_deg = 0.0f;
  lidar->rx_time_us = 0;
  lidar->timestamp_ms = 0;
  lidar->rx_count = 0;
  lidar->rx_error_count = 0;

  for (int i = 0; i < LD06_POINT_PER_PACK; i++) {
    lidar->points[i].distance = 0;
    lidar->points[i].confidence = 0;
    lidar->points[i].angle = 0.0f;
  }
}

// 1パケット分だけ処理して返す。points[] は次のパケットで上書きされるため、まとめて
// 読み進めると溜まっていた分の点を取りこぼす。呼び出し側は false が返るまで繰り返すこと
bool LD06_Update(LD06* lidar) {
  while (Serial_Available(lidar->serial)) {
    uint8_t b = Serial_Read(lidar->serial);

    switch (lidar->rx_state) {
      case 0:
        if (b == 0x54) {  // データの始まりを示すヘッダ
          lidar->rx_buf[0] = b;
          lidar->rx_state = 1;
        }
        break;

      case 1:
        // 下位5ビットが測定点の数（12点）であることを確認
        if ((b & 0x1F) == LD06_POINT_PER_PACK) {
          lidar->rx_buf[1] = b;
          lidar->rx_state = 2;
        } else if (b == 0x54) {
          // ヘッダに続かなかった場合、このバイト自体が次のヘッダかもしれないので
          // 読み捨てずに state=0 (ヘッダ探索) の判定を同じバイトへ適用し直す
          lidar->rx_buf[0] = b;
          lidar->rx_state = 1;
        } else {
          lidar->rx_state = 0;  // ヘッダにもヘッダ候補にも合致しなかった
        }
        break;

      default:
        lidar->rx_buf[lidar->rx_state++] = b;

        // パケットの最後まで受信した場合
        if (lidar->rx_state == LD06_PACKET_SIZE) {
          // CRC8をチェック (最後の1バイト以外で計算して比較)
          uint8_t crc = CalCRC8(lidar->rx_buf, LD06_PACKET_SIZE - 1);

          if (crc == lidar->rx_buf[LD06_PACKET_SIZE - 1]) {
            // 上位へ送るタイムスタンプの基準。パケット末尾を処理した時刻なので、
            // 各点の取得時刻はここから回転速度で遡って求める (点群の歪み補正に使う)
            lidar->rx_time_us = Micros();
            lidar->speed_dps = (float)((lidar->rx_buf[3] << 8) | lidar->rx_buf[2]);

            // 単位は 0.01 degree なので 100 で割る
            float start_angle = ((lidar->rx_buf[5] << 8) | lidar->rx_buf[4]) / 100.0f;
            float end_angle = ((lidar->rx_buf[43] << 8) | lidar->rx_buf[42]) / 100.0f;
            lidar->timestamp_ms = (lidar->rx_buf[45] << 8) | lidar->rx_buf[44];

            // 12個のポイントの角度差分（ステップ）を計算。360度を跨ぐ場合を考慮。
            lidar->span_deg = (end_angle < start_angle) ? (end_angle + 360.0f - start_angle)
                                                        : (end_angle - start_angle);
            float step = lidar->span_deg / (LD06_POINT_PER_PACK - 1);

            for (int i = 0; i < LD06_POINT_PER_PACK; i++) {
              int base_idx = 6 + i * 3;
              lidar->points[i].distance = (lidar->rx_buf[base_idx + 1] << 8) | lidar->rx_buf[base_idx];
              lidar->points[i].confidence = lidar->rx_buf[base_idx + 2];

              float angle = start_angle + step * i;
              while (angle >= 360.0f) angle -= 360.0f;
              lidar->points[i].angle = angle;
            }

            lidar->rx_count++;
            lidar->rx_state = 0;
            return true;
          } else {
            // ここで printf を出すと、ノイズが乗ったときに毎パケット出力して制御ループを
            // 止めてしまう。件数だけ数え、通信品質は rx_count との比で判断する
            lidar->rx_error_count++;
          }

          // CRC不一致だったパケットを捨てて、次のパケットの頭を探し直す
          lidar->rx_state = 0;
        }
        break;
    }
  }

  return false;
}
